## interrupt_hardware_gpio/dts/bindings/gpio-pins.yaml
```yaml
description: GPIO pin for interrupt

compatible: "gpio-pins"

properties:
  gpios:
    type: phandle-array
    required: true
    description: |
      The GPIO pin for interrupt
```
